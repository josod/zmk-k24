## boards/shields/kyria-k24/Kconfig.shield
```kconfig
# Copyright (c) 2020 Pete Johanson
# SPDX-License-Identifier: MIT

config SHIELD_KYRIA_24
    bool

config SHIELD_KYRIA_K24_LEFT
    def_bool $(shields_list_contains,kyria_k24_left)
    select SHIELD_KYRIA_K24

config SHIELD_KYRIA_K24_LEFT_RIGHT
    def_bool $(shields_list_contains,kyria_k24_right)
    select SHIELD_KYRIA_K24
```
